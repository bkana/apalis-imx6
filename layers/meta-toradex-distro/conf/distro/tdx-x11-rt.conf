## layers/meta-toradex-distro/conf/distro/tdx-x11-rt.conf
```bitbake
# Toradex Distro with X11 without wayland.
# Using the downstream kernel flavour with rt-patch applied.

require conf/distro/tdx-x11.conf

DISTRO = "tdx-x11-rt"
DISTRO_NAME = "TDX X11 RT"
DISTROOVERRIDES .= ":preempt-rt"
DISTRO_FLAVOUR = " (X11 PREEMPT_RT)"

IMAGE_BASENAME:append = "-rt"
```

## layers/meta-toradex-distro/conf/distro/tdx-x11-upstream-rt.conf
```bitbake
# Toradex Distro with X11 without wayland.
# Using the upstream kernel flavour with rt-patch applied.

require conf/distro/tdx-x11-upstream.conf

DISTRO = "tdx-x11-upstream-rt"
DISTRO_NAME = "TDX X11 Upstream RT"
DISTROOVERRIDES .= ":preempt-rt"
DISTRO_FLAVOUR = " (X11 UPSTREAM PREEMPT_RT)"

IMAGE_BASENAME:append = "-rt"
```

## layers/meta-toradex-distro/conf/distro/tdx-x11-upstream.conf
```bitbake
# Toradex Distro with X11 without wayland.
# Using the upstream kernel flavour.

require conf/distro/tdx-x11.conf

DISTRO = "tdx-x11-upstream"
DISTRO_NAME = "TDX X11 Upstream"
DISTROOVERRIDES .= ":upstream"
DISTRO_FLAVOUR = " (X11 UPSTREAM)"

IMX_DEFAULT_BSP = "mainline"

IMAGE_BASENAME:append = "-upstream"
```

## layers/meta-toradex-distro/conf/distro/tdx-x11.conf
```bitbake
# Toradex Distro with X11 without wayland.
# Using the downstream kernel flavour.

require conf/distro/include/tdx-base.inc

DISTRO = "tdx-x11"
DISTRO_NAME = "TDX X11"
DISTRO_FLAVOUR = "(X11)"

IMAGE_BASENAME:append = "-x11"

IMX_DEFAULT_BSP = "nxp"

# Remove conflicting backends.
DISTRO_FEATURES:remove = "wayland "

# we use graphics, so set opengl
DISTRO_FEATURES:append = " opengl"

# These are X11 specific
DISTRO_FEATURES:append = " x11"

# lxqt requires this
DISTRO_FEATURES:append = " polkit"
```

## layers/meta-toradex-nxp/conf/machine/include/apalis-imx6.inc
```bitbake
IMAGE_CLASSES:append = " image_type_tezi"
IMAGE_FSTYPES:append = " teziimg"
# The payload offsets are given in number of 512 byte blocks.
OFFSET_BOOTROM_PAYLOAD = "2"
OFFSET_SPL_PAYLOAD = "138"
TORADEX_PRODUCT_IDS = "0027 0028 0029 0035"

MACHINE_NAME = "Apalis-iMX6"

TEZI_EXTERNAL_KERNEL_DEVICETREE_BOOT:use-mainline-bsp = " \
    apalis-imx6_hdmi_overlay.dtbo \
    apalis-imx6_spi1_spidev_overlay.dtbo \
    apalis-imx6_spi2_spidev_overlay.dtbo \
"
TEZI_EXTERNAL_KERNEL_DEVICETREE_BOOT = ""

KERNEL_DEVICETREE:append = " \
    imx6q-apalis-ixora-v1.2.dtb \
"

PREFERRED_PROVIDER_virtual/kernel = "linux-toradex"
PREFERRED_PROVIDER_virtual/kernel:preempt-rt = "linux-toradex"
PREFERRED_PROVIDER_virtual/kernel:use-mainline-bsp = "linux-toradex-mainline"
PREFERRED_PROVIDER_virtual/kernel:use-mainline-bsp:preempt-rt = "linux-toradex-mainline-rt"
PREFERRED_PROVIDER_virtual/dtb:use-mainline-bsp = "device-tree-overlays-mainline"

IMX_DEFAULT_BOOTLOADER:apalis-imx6 = "u-boot-toradex"
PREFERRED_PROVIDER_u-boot-default-script = "u-boot-distro-boot"
UBOOT_SUFFIX = "img"

MACHINE_FIRMWARE:remove = "firmware-imx-epdc"

UBOOT_DTB_LOADADDRESS:apalis-imx6 = "0x18200000"
UBOOT_DTBO_LOADADDRESS:apalis-imx6 = "0x18300000"
UBOOT_ENTRYPOINT:apalis-imx6 = "0x14200000"
UBOOT_RD_LOADADDRESS:apalis-imx6 = "0x1A400000"
```

## layers/meta-toradex-nxp/conf/machine/include/colibri-imx6.inc
```bitbake
IMAGE_CLASSES:append = " image_type_tezi"
IMAGE_FSTYPES:append = " teziimg"
# The payload offsets are given in number of 512 byte blocks.
OFFSET_BOOTROM_PAYLOAD = "2"
OFFSET_SPL_PAYLOAD = "138"
TORADEX_PRODUCT_IDS = "0014 0015 0016 0017"

MACHINE_NAME = "Colibri-iMX6"

TEZI_EXTERNAL_KERNEL_DEVICETREE_BOOT:use-mainline-bsp = " \
    colibri-imx6_vga-640x480_overlay.dtbo \
"
TEZI_EXTERNAL_KERNEL_DEVICETREE_BOOT = ""

KERNEL_DEVICETREE:append = " \
    imx6dl-colibri-aster.dtb \
    imx6dl-colibri-iris.dtb \
    imx6dl-colibri-iris-v2.dtb \
"

PREFERRED_PROVIDER_virtual/kernel = "linux-toradex"
PREFERRED_PROVIDER_virtual/kernel:preempt-rt = "linux-toradex"
PREFERRED_PROVIDER_virtual/kernel:use-mainline-bsp = "linux-toradex-mainline"
PREFERRED_PROVIDER_virtual/kernel:use-mainline-bsp:preempt-rt = "linux-toradex-mainline-rt"
PREFERRED_PROVIDER_virtual/dtb:use-mainline-bsp = "device-tree-overlays-mainline"

IMX_DEFAULT_BOOTLOADER:colibri-imx6 = "u-boot-toradex"
PREFERRED_PROVIDER_u-boot-default-script = "u-boot-distro-boot"
UBOOT_SUFFIX = "img"

MACHINE_FIRMWARE:remove = "firmware-imx-epdc"

UBOOT_DTB_LOADADDRESS:colibri-imx6 = "0x18200000"
UBOOT_DTBO_LOADADDRESS:colibri-imx6 = "0x18300000"
UBOOT_ENTRYPOINT:colibri-imx6 = "0x14200000"
UBOOT_RD_LOADADDRESS:colibri-imx6 = "0x1A400000"
```

## layers/meta-toradex-nxp/conf/machine/include/colibri-imx7-emmc.inc
```bitbake
IMAGE_CLASSES:append = " image_type_tezi"
IMAGE_FSTYPES:append = " teziimg"
# The payload offsets are given in number of 512 byte blocks.
OFFSET_BOOTROM_PAYLOAD = "2"
TORADEX_PRODUCT_IDS = "0039"
TORADEX_FLASH_TYPE = "emmc"

MACHINE_NAME = "Colibri-iMX7-eMMC"

TEZI_EXTERNAL_KERNEL_DEVICETREE_BOOT:use-mainline-bsp = " \
    colibri-imx7_vga-640x480_overlay.dtbo \
"
TEZI_EXTERNAL_KERNEL_DEVICETREE_BOOT = ""

KERNEL_DEVICETREE:append = " \
    imx7d-colibri-emmc-iris.dtb \
    imx7d-colibri-emmc-iris-v2.dtb \
"

PREFERRED_PROVIDER_virtual/kernel = "linux-toradex"
PREFERRED_PROVIDER_virtual/kernel:preempt-rt = "linux-toradex"
PREFERRED_PROVIDER_virtual/kernel:use-mainline-bsp = "linux-toradex-mainline"
PREFERRED_PROVIDER_virtual/kernel:use-mainline-bsp:preempt-rt = "linux-toradex-mainline-rt"
PREFERRED_PROVIDER_virtual/dtb:use-mainline-bsp = "device-tree-overlays-mainline"

IMX_DEFAULT_BOOTLOADER:colibri-imx7-emmc = "u-boot-toradex"
PREFERRED_PROVIDER_u-boot-default-script = "u-boot-distro-boot"

MACHINE_FIRMWARE:remove = "firmware-imx-epdc"
MACHINE_FIRMWARE:remove:use-mainline-bsp = "firmware-imx-vpu-imx6q firmware-imx-vpu-imx6d"

UBOOT_BINARY:colibri-imx7-emmc = "u-boot.imx"
UBOOT_DTB_LOADADDRESS:colibri-imx7-emmc = "0x88200000"
UBOOT_DTBO_LOADADDRESS:colibri-imx7-emmc = "0x88300000"
UBOOT_ENTRYPOINT:colibri-imx7-emmc = "0x84200000"
UBOOT_MAKE_TARGET:colibri-imx7-emmc = "u-boot.imx"
UBOOT_RD_LOADADDRESS:colibri-imx7-emmc = "0x8A400000"
UBOOT_SUFFIX:${MACHINE} = "imx"
```

## layers/meta-toradex-nxp/conf/machine/include/colibri-imx7.inc
```bitbake
IMAGE_CLASSES:append = " image_type_tezi"
IMAGE_FSTYPES:append = " teziimg"
TORADEX_PRODUCT_IDS = "0032 0033 0041"
TORADEX_PRODUCT_IDS[0032] = "imx7s-colibri-eval-v3.dtb"
TORADEX_PRODUCT_IDS[0033] = "imx7d-colibri-eval-v3.dtb"
TORADEX_PRODUCT_IDS[0041] = "imx7d-colibri-eval-v3.dtb"
TORADEX_FLASH_TYPE = "rawnand"

MACHINE_NAME = "Colibri-iMX7"

KERNEL_DEVICETREE:append = " \
    imx7d-colibri-iris.dtb \
    imx7d-colibri-iris-v2.dtb \
    imx7s-colibri-iris.dtb \
    imx7s-colibri-iris-v2.dtb \
"

PREFERRED_PROVIDER_virtual/kernel = "linux-toradex"
PREFERRED_PROVIDER_virtual/kernel:preempt-rt = "linux-toradex"
PREFERRED_PROVIDER_virtual/kernel:use-mainline-bsp = "linux-toradex-mainline"
PREFERRED_PROVIDER_virtual/kernel:use-mainline-bsp:preempt-rt = "linux-toradex-mainline-rt"
PREFERRED_PROVIDER_virtual/dtb:use-mainline-bsp = "device-tree-overlays-mainline"

IMX_DEFAULT_BOOTLOADER:colibri-imx7 = "u-boot-toradex"
PREFERRED_PROVIDER_u-boot-default-script = "u-boot-distro-boot"

MACHINE_FIRMWARE:remove = "firmware-imx-epdc"
MACHINE_FIRMWARE:remove:use-mainline-bsp = "firmware-imx-vpu-imx6q firmware-imx-vpu-imx6d"

UBOOT_DTB_LOADADDRESS:colibri-imx7 = "0x88200000"
UBOOT_DTBO_LOADADDRESS:colibri-imx7 = "0x88300000"
UBOOT_ENTRYPOINT:colibri-imx7 = "0x84200000"
UBOOT_MAKE_TARGET:colibri-imx7 = "u-boot-nand.imx"
UBOOT_RD_LOADADDRESS:colibri-imx7 = "0x88400000"
```

## layers/meta-toradex-nxp/conf/machine/verdin-imx8mm.conf
```bitbake
#@TYPE: Machine
#@NAME: Toradex Verdin iMX8M Mini
#@SOC: i.MX8MM
#@DESCRIPTION: Machine configuration for Toradex Verdin iMX8M Mini SoM
#@MAINTAINER: Max Krummenacher <max.krummenacher@toradex.com>

MACHINE_NAME = "Verdin-iMX8MM"

MACHINEOVERRIDES =. "mx8:mx8m:mx8mm:"

MACHINE_EXTRA_RRECOMMENDS:append = " mwifiexconf"

IMX_DEFAULT_BSP = "nxp"
IMX_DEFAULT_BSP:upstream = "mainline"

require conf/machine/include/imx-base.inc
# override imx-base.inc which sets this to cortexa53-crypto
DEFAULTTUNE:mx8mm-generic-bsp = "armv8a-crypto"
require conf/machine/include/arm/armv8a/tune-cortexa53.inc

# Don't include kernels in standard images
RRECOMMENDS:${KERNEL_PACKAGE_NAME}-base = ""

KERNEL_DEVICETREE = " \
    freescale/imx8mm-verdin-nonwifi-dahlia.dtb \
    freescale/imx8mm-verdin-nonwifi-dev.dtb \
    freescale/imx8mm-verdin-nonwifi-yavia.dtb \
    freescale/imx8mm-verdin-wifi-dahlia.dtb \
    freescale/imx8mm-verdin-wifi-dev.dtb \
    freescale/imx8mm-verdin-wifi-yavia.dtb \
"
KERNEL_IMAGETYPE:aarch64 = "Image.gz"

UBOOT_CONFIG ??= "sd"
UBOOT_CONFIG[sd] = "verdin-imx8mm_defconfig,sdcard"
SPL_BINARY = "spl/u-boot-spl.bin"

UBOOT_DTB_LOADADDRESS:mx8mm-generic-bsp = "0x50200000"
UBOOT_DTBO_LOADADDRESS:mx8mm-generic-bsp = "0x50240000"
UBOOT_ENTRYPOINT:mx8mm-generic-bsp  = "0x48200000"
UBOOT_RD_LOADADDRESS = "0x52300000"

# Set u-boot DTB
UBOOT_DTB_NAME = "imx8mm-verdin.dtb"

# Set DDR FIRMWARE
DDR_FIRMWARE_NAME = " \
    lpddr4_pmu_train_1d_imem.bin \
    lpddr4_pmu_train_1d_dmem.bin \
    lpddr4_pmu_train_2d_imem.bin \
    lpddr4_pmu_train_2d_dmem.bin \
"

ATF_PLATFORM = "imx8mm"
SOC_ATF_BOOT_UART_BASE:verdin-imx8mm = "0x30860000"

BOOT_SPACE = "65536"

# Set imx-mkimage boot target
IMXBOOT_TARGETS = "flash_evk_emmc_fastboot"
IMX_BOOT_SOC_TARGET = "iMX8MM"

IMAGE_BOOT_FILES:append = " boot.scr-${MACHINE};boot.scr"
WKS_FILE_DEPENDS:append = " u-boot-default-script"
PREFERRED_PROVIDER_u-boot-default-script = "u-boot-distro-boot"

LOADADDR = ""
UBOOT_SUFFIX = "bin"
UBOOT_MAKE_TARGET = ""
IMX_BOOT_SEEK = "33"

SERIAL_CONSOLES = "115200;ttymxc0"

MACHINE_FEATURES += "3g bluetooth alsa ext2 pci screen touchscreen usbgadget usbhost vfat wifi"

PREFERRED_PROVIDER_virtual/kernel = "linux-toradex"
PREFERRED_PROVIDER_virtual/kernel:preempt-rt = "linux-toradex"
PREFERRED_PROVIDER_virtual/kernel:use-mainline-bsp = "linux-toradex-mainline"
PREFERRED_PROVIDER_virtual/kernel:use-mainline-bsp:preempt-rt = "linux-toradex-mainline-rt"
PREFERRED_PROVIDER_virtual/dtb:use-mainline-bsp = "device-tree-overlays-mainline"
MACHINE_EXTRA_RRECOMMENDS:append:use-mainline-bsp = " modprobe-conf"

IMX_DEFAULT_BOOTLOADER = "u-boot-toradex"
# Currently we use the nxp 2022.04 downstream for mx8
PREFERRED_VERSION_u-boot-toradex = "2022.04%"

# handle machine firmware
MACHINE_FIRMWARE:append = " linux-firmware-ath10k linux-firmware-imx-sdma-imx7d"
MACHINE_FIRMWARE:append = " linux-firmware-sd8997"
MACHINE_FIRMWARE:append = " firmware-imx-vpu-imx8"

BOARD_TYPE = "verdin"

IMAGE_CLASSES:append = " image_type_tezi"
IMAGE_FSTYPES += "teziimg"

UBOOT_BINARY_TEZI_EMMC = "imx-boot"
OFFSET_BOOTROM_PAYLOAD = "2"

TEZI_EXTERNAL_KERNEL_DEVICETREE_BOOT = "verdin-imx8mm_dsi-to-hdmi_overlay.dtbo verdin-imx8mm_spidev_overlay.dtbo"
TEZI_EXTERNAL_KERNEL_DEVICETREE_BOOT:use-mainline-bsp = "verdin-imx8mm_spidev_overlay.dtbo"

TORADEX_PRODUCT_IDS = "0055 0057 0059 0060 0068"
TORADEX_PRODUCT_IDS[0055] = "imx8mm-verdin-wifi-v1.1-dev.dtb"
TORADEX_PRODUCT_IDS[0057] = "imx8mm-verdin-nonwifi-v1.1-dev.dtb"
TORADEX_PRODUCT_IDS[0059] = "imx8mm-verdin-nonwifi-v1.1-dev.dtb"
TORADEX_PRODUCT_IDS[0060] = "imx8mm-verdin-wifi-v1.1-dev.dtb"
TORADEX_PRODUCT_IDS[0068] = "imx8mm-verdin-wifi-v1.1-dev.dtb"
```

## layers/meta-toradex-ti/conf/machine/verdin-am62-k3r5.conf
```bitbake
#@TYPE: Machine
#@NAME: Toradex Verdin AM62 (R5F)
#@DESCRIPTION: Machine configuration for Toradex Verdin AM62 SoM (R5F core)
#@MAINTAINER: Max Krummenacher <max.krummenacher@toradex.com>

MACHINE_NAME = "Verdin-AM62"

require conf/machine/include/k3r5.inc

PREFERRED_PROVIDER_virtual/bootloader = "u-boot-toradex-ti"
PREFERRED_PROVIDER_u-boot = "u-boot-toradex-ti"
PREFERRED_PROVIDER_virtual/bootloader:upstream:use-head-next = "u-boot-toradex"
PREFERRED_PROVIDER_u-boot:upstream:use-head-next = "u-boot-toradex"

SYSFW_SOC = "am62x"
SYSFW_CONFIG = "verdin"
SYSFW_SUFFIX = "gp"

UBOOT_DFU_CONFIG = "dfu-gp"
# The DFU config does not (yet) exist in upstream. It is needed only
# if booting from DFU/USB.
UBOOT_DFU_CONFIG:upstream = ""
UBOOT_CONFIG ??= "${UBOOT_DFU_CONFIG} sd-gp"
UBOOT_CONFIG[dfu-gp] = "verdin-am62_r5_usbdfu_defconfig,dfu,spl/u-boot-spl.bin"
UBOOT_CONFIG[sd-gp] = "verdin-am62_r5_defconfig,sdcard,spl/u-boot-spl.bin"
```
